; *************************************************************
; *** Scatter-Loading Description File generated by uVision ***
; *************************************************************

LR_ROM1 0x90000000 0x00200000  {    ; load region size_region
  ER_ROM1 0x90000000 0x00200000  {  ; load address = execution address
   *.o (RESET, +First)
   *(InRoot$$Sections)
   .ANY (+RO)
   .ANY (+XO)
  }
  RW_RAM1 0x30000000 0x00048000  {  ; RW data
    lv_disp.o (+RO)
    lv_event.o (+RO)
    lv_group.o (+RO)
    lv_indev.o (+RO)
    lv_indev_scroll.o (+RO)
    lv_obj.o (+RO)
    lv_obj_class.o (+RO)
    lv_obj_draw.o (+RO)
    lv_obj_pos.o (+RO)
    lv_obj_scroll.o (+RO)
    lv_obj_style.o (+RO)
    lv_obj_style_gen.o (+RO)
    lv_obj_tree.o (+RO)
    lv_refr.o (+RO)
    lv_theme.o (+RO)
    lv_draw.o (+RO)
    lv_draw_arc.o (+RO)
    lv_draw_img.o (+RO)
    lv_draw_label.o (+RO)
    lv_draw_layer.o (+RO)
    lv_draw_line.o (+RO)
    lv_draw_mask.o (+RO)
    lv_draw_rect.o (+RO)
    lv_draw_transform.o (+RO)
    lv_draw_triangle.o (+RO)
    lv_img_buf.o (+RO)
    lv_img_cache.o (+RO)
    lv_img_decoder.o (+RO)
    lv_gpu_arm2d.o (+RO)
    lv_draw_pxp.o (+RO)
    lv_draw_pxp_blend.o (+RO)
    lv_gpu_nxp_pxp.o (+RO)
    lv_gpu_nxp_pxp_osa.o (+RO)
    lv_draw_vglite.o (+RO)
    lv_draw_vglite_arc.o (+RO)
    lv_draw_vglite_blend.o (+RO)
    lv_draw_vglite_line.o (+RO)
    lv_draw_vglite_rect.o (+RO)
    lv_vglite_buf.o (+RO)
    lv_vglite_utils.o (+RO)
    lv_gpu_d2_draw_label.o (+RO)
    lv_gpu_d2_ra6m3.o (+RO)
    lv_draw_sdl.o (+RO)
    lv_draw_sdl_arc.o (+RO)
    lv_draw_sdl_bg.o (+RO)
    lv_draw_sdl_composite.o (+RO)
    lv_draw_sdl_img.o (+RO)
    lv_draw_sdl_label.o (+RO)
    lv_draw_sdl_layer.o (+RO)
    lv_draw_sdl_line.o (+RO)
    lv_draw_sdl_mask.o (+RO)
    lv_draw_sdl_polygon.o (+RO)
    lv_draw_sdl_rect.o (+RO)
    lv_draw_sdl_stack_blur.o (+RO)
    lv_draw_sdl_texture_cache.o (+RO)
    lv_draw_sdl_utils.o (+RO)
    lv_gpu_stm32_dma2d.o (+RO)
    lv_draw_sw.o (+RO)
    lv_draw_sw_arc.o (+RO)
    lv_draw_sw_blend.o (+RO)
    lv_draw_sw_dither.o (+RO)
    lv_draw_sw_gradient.o (+RO)
    lv_draw_sw_img.o (+RO)
    lv_draw_sw_layer.o (+RO)
    lv_draw_sw_letter.o (+RO)
    lv_draw_sw_line.o (+RO)
    lv_draw_sw_polygon.o (+RO)
    lv_draw_sw_rect.o (+RO)
    lv_draw_sw_transform.o (+RO)
    lv_gpu_swm341_dma2d.o (+RO)
    lv_flex.o (+RO)
    lv_grid.o (+RO)
    lv_bmp.o (+RO)
    lv_ffmpeg.o (+RO)
    lv_freetype.o (+RO)
    lv_fs_fatfs.o (+RO)
    lv_fs_littlefs.o (+RO)
    lv_fs_posix.o (+RO)
    lv_fs_stdio.o (+RO)
    lv_fs_win32.o (+RO)
    gifdec.o (+RO)
    lv_gif.o (+RO)
    lodepng.o (+RO)
    lv_png.o (+RO)
    lv_qrcode.o (+RO)
    qrcodegen.o (+RO)
    lv_rlottie.o (+RO)
    lv_sjpg.o (+RO)
    tjpgd.o (+RO)
    lv_tiny_ttf.o (+RO)
    lv_fragment.o (+RO)
    lv_fragment_manager.o (+RO)
    lv_gridnav.o (+RO)
    lv_ime_pinyin.o (+RO)
    lv_imgfont.o (+RO)
    lv_monkey.o (+RO)
    lv_msg.o (+RO)
    lv_snapshot.o (+RO)
    lv_theme_basic.o (+RO)
    lv_theme_default.o (+RO)
    lv_theme_mono.o (+RO)
    lv_animimg.o (+RO)
    lv_calendar.o (+RO)
    lv_calendar_header_arrow.o (+RO)
    lv_calendar_header_dropdown.o (+RO)
    lv_chart.o (+RO)
    lv_colorwheel.o (+RO)
    lv_imgbtn.o (+RO)
    lv_keyboard.o (+RO)
    lv_led.o (+RO)
    lv_list.o (+RO)
    lv_menu.o (+RO)
    lv_meter.o (+RO)
    lv_msgbox.o (+RO)
    lv_span.o (+RO)
    lv_spinbox.o (+RO)
    lv_spinner.o (+RO)
    lv_tabview.o (+RO)
    lv_tileview.o (+RO)
    lv_win.o (+RO)
    lv_extra.o (+RO)
    lv_font.o (+RO)
    lv_font_dejavu_16_persian_hebrew.o (+RO)
    lv_font_fmt_txt.o (+RO)
    lv_font_loader.o (+RO)
    lv_font_montserrat_8.o (+RO)
    lv_font_montserrat_10.o (+RO)
    lv_font_montserrat_12.o (+RO)
    lv_font_montserrat_12_subpx.o (+RO)
    lv_font_montserrat_14.o (+RO)
    lv_font_montserrat_16.o (+RO)
    lv_font_montserrat_18.o (+RO)
    lv_font_montserrat_20.o (+RO)
    lv_font_montserrat_22.o (+RO)
    lv_font_montserrat_24.o (+RO)
    lv_font_montserrat_26.o (+RO)
    lv_font_montserrat_28.o (+RO)
    lv_font_montserrat_28_compressed.o (+RO)
    lv_font_montserrat_30.o (+RO)
    lv_font_montserrat_32.o (+RO)
    lv_font_montserrat_34.o (+RO)
    lv_font_montserrat_36.o (+RO)
    lv_font_montserrat_38.o (+RO)
    lv_font_montserrat_40.o (+RO)
    lv_font_montserrat_42.o (+RO)
    lv_font_montserrat_44.o (+RO)
    lv_font_montserrat_46.o (+RO)
    lv_font_montserrat_48.o (+RO)
    lv_font_simsun_16_cjk.o (+RO)
    lv_font_unscii_8.o (+RO)
    lv_font_unscii_16.o (+RO)
    lv_hal_disp.o (+RO)
    lv_hal_indev.o (+RO)
    lv_hal_tick.o (+RO)
    lv_anim.o (+RO)
    lv_anim_timeline.o (+RO)
    lv_area.o (+RO)
    lv_async.o (+RO)
    lv_bidi.o (+RO)
    lv_color.o (+RO)
    lv_fs.o (+RO)
    lv_gc.o (+RO)
    lv_ll.o (+RO)
    lv_log.o (+RO)
    lv_lru.o (+RO)
    lv_math.o (+RO)
    lv_mem.o (+RO)
    lv_printf.o (+RO)
    lv_style.o (+RO)
    lv_style_gen.o (+RO)
    lv_templ.o (+RO)
    lv_timer.o (+RO)
    lv_tlsf.o (+RO)
    lv_txt.o (+RO)
    lv_txt_ap.o (+RO)
    lv_utils.o (+RO)
    lv_arc.o (+RO)
    lv_bar.o (+RO)
    lv_btn.o (+RO)
    lv_btnmatrix.o (+RO)
    lv_canvas.o (+RO)
    lv_checkbox.o (+RO)
    lv_dropdown.o (+RO)
    lv_img.o (+RO)
    lv_label.o (+RO)
    lv_line.o (+RO)
    lv_objx_templ.o (+RO)
    lv_roller.o (+RO)
    lv_slider.o (+RO)
    lv_switch.o (+RO)
    lv_table.o (+RO)
    lv_textarea.o (+RO)
   .ANY (+RW +ZI)
  }
  RW_RAM2 0x38000000 0x00010000  {
   .ANY (+RW +ZI)
  }
  RW_IRAM1 0x20000000 0x00020000  {
   .ANY (+RW +ZI)
  }
  RW_IRAM2 0x24000000 0x00080000  {
   .ANY (+RW +ZI)
  }
}

